## drivers/input/touchscreen/sec_ts_y661/Kconfig
```kconfig
#
# Samsung Electronics TOUCH driver configuration
#

if INPUT_TOUCHSCREEN

config TOUCHSCREEN_SEC_TS_Y661
        tristate "Samsung Electronics Touchscreen"
        depends on I2C
        help
          Say Y here if you want support for SEC touchscreen controllers.

config TOUCHSCREEN_SEC_TS_GLOVEMODE
        tristate "Samsung Electronics Touchscreen"
        depends on I2C
        help
          Say Y here if you have a Samsung Electronics Touchscreen and want to enable
          support for the built-in touchscreen.

endif
```

## drivers/misc/mediatek/imgsensor/src/Kconfig
```kconfig
config MTK_IMGSENSOR_SPECIFY_SENSOR
  bool MTK_IMGSENSOR_SPECIFY_SENSOR
  depends on MTK_IMGSENSOR
  help
    Specify name of each sensor to prevent obtaining wrong sensor driver with same sensor ID.
    For example, imx258_mipi_raw and imx258_mipi_mono are of same sensor ID. If not specifying
    sensor, imx258_mipi_mono may be recognized as imx258_mipi_raw.

config MTK_IMGSENSOR_MAIN
  string "Custom main image sensor"
  depends on MTK_IMGSENSOR_SPECIFY_SENSOR
  help
    Specify main sensor.

config MTK_IMGSENSOR_SUB
  string "Custom sub image sensor"
  depends on MTK_IMGSENSOR_SPECIFY_SENSOR
  help
    Specify sub sensor.

config MTK_IMGSENSOR_MAIN2
  string "Custom main2 image sensor"
  depends on MTK_IMGSENSOR_SPECIFY_SENSOR
  help
    Specify main2 sensor.

config MTK_IMGSENSOR_SUB2
  string "Custom sub2 image sensor"
  depends on MTK_IMGSENSOR_SPECIFY_SENSOR
  help
    Specify sub2 sensor.
```

## drivers/misc/mediatek/rtc/Kconfig
```kconfig
# RTC Related
config MTK_RTC
	bool "MediaTek Real Time Clock Support"
	default n
	---help---
	  MediaTek RTC driver
config RTC_AUTO_PWRON
        bool "RTC Auto Power On Alarm by PMICs"
        default n
        help
          Support for the auto power on alarm on alarm booting supporting PMICs.
          Say Y if you want to enable this feature.
```

## drivers/misc/mediatek/secwidevine/Kconfig
```kconfig
config BLOWFISH_TEE_SUPPORT
	bool "Enable Blowfish TEE Support"
	default y
	help
	  Enable Blowfish TEE Support
```

## drivers/sensors/Kconfig
```kconfig
#
# Sensor  drivers configuration
#

menuconfig SENSORS
	bool "Sensor devices"
	help
	  Say Y here, and a list of sensors drivers will be displayed.
	  Everything that didn't fit into the other categories is here. This option
	  doesn't affect the kernel.

	  If unsure, say Y.

config SENSORS_CORE
	bool "Sensors Class Support"
	help
	  This option enables the sensor sysfs class in /sys/class/sensors.
	  You'll need this to do anything useful with sensorss. If unsure, say N.

config ST_LSM6DS3
	tristate "STMicroelectronics LSM6DS3 sensor"
	depends on (I2C || SPI) && SYSFS
	help
	  This driver supports the STMicroelectronics LSM6DS3 sensor.
	  It is a gyroscope/accelerometer combo device.
	  This driver can be built as a module. The module will be called
	  st-lsm6ds3.

config ST_LSM6DS3_I2C
	tristate "STMicroelectronics LSM6DS3 sensor"
	depends on (I2C || SPI) && SYSFS
	help
	  This driver supports the STMicroelectronics LSM6DS3 sensor.
	  It is a gyroscope/accelerometer combo device.
	  This driver can be built as a module. The module will be called
	  st-lsm6ds3.

config SENSORS_LSM6DSL
	tristate "STMicroelectronics LSM6DSL sensor"
	depends on (I2C || SPI) && SYSFS
	help
	   This driver support the STMicroelectronics LSM6DSL sensor.

	   To compile this driver as a module, choose M here. The module
	   will be called lsm6dsl.

config SENSORS_LSM6DSL_I2C
	tristate "STMicroelectronics LSM6DSL sensor"
	depends on (I2C || SPI) && SYSFS
	help
	   This driver support the STMicroelectronics LSM6DSL sensor.

config SENSORS_CM36657
	depends on I2C
	tristate "CM36657 driver"
	default n
	help
	  This option enables proximity & light sensors using CM36657 driver.

config SENSORS_CM36686
	depends on I2C
	tristate "CM36686 driver"
	default n
	help
	  This option enables proximity & light sensors using CM36686 driver.

config SENSORS_TMD3725
	depends on I2C
	tristate "TMD3725 driver"
	default n
	help
	   This option enables proximity & light sensors using TMD3725 driver.

config SENSORS_AK09916C
	tristate "AK09916C compass support"
	default n
	depends on I2C
	help
	  If you say yes here you get support for Asahi Kasei's
	  orientation sensor AK09916C.

config SENSORS_YAS539
	tristate "YAS539 Sensor Driver"
	depends on I2C
	default n
	help
	  If you say yes here you get support for YAMAHA
	  YAS539 Geomagnitor Sensor.

config SENSORS_SX9320
	depends on I2C
	tristate "SX9320 driver"
	default n
	help
	  Say Y here if you use sx9320.
	  This option enables grip sensors using
	  SemTech sx9320 device driver.
	  Say N here if you do not use sx9320.
```
